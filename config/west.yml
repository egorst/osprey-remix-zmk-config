## config/west.yml
```yaml
manifest:
  remotes:
    - name: egorst
      url-base: https://github.com/egorst
    # Additional modules containing boards/shields/custom code can be listed here as well
    # See https://docs.zephyrproject.org/3.2.0/develop/west/manifest.html#projects
  projects:
    - name: zmk
      remote: egorst
      revision: main
      import: app/west.yml
  self:
    path: config
```
